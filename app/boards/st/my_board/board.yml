## app/boards/st/my_board/board.yml
```yaml
board:
  name: my_board
  full_name: My Custom Board (built from scratch)
  vendor: st
  socs:
    - name: stm32u575xx
```

## app/boards/st/my_board/my_board_defconfig
```kconfig
# SPDX-License-Identifier: Apache-2.0

# Console + UART (so printk works)
CONFIG_SERIAL=y
CONFIG_CONSOLE=y
CONFIG_UART_CONSOLE=y

# GPIO (for the external LED)
CONFIG_GPIO=y

# Cortex-M33 protection — cheap and catches stack overflows during bring-up
CONFIG_ARM_MPU=y
CONFIG_HW_STACK_PROTECTION=y
```

## app/boards/st/our_board/board.yml
```yaml
board:
  name: our_board
  full_name: Our Custom Board
  vendor: st
  socs:
    - name: stm32u575xx
```
